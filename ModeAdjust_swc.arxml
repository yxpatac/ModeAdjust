[part 4 of 4: packages /PATAC/MSM/ComponentTypes to /PATAC/MSM/PortInterfaces]
AUTOSAR XML (schema 4-0-3)
package /PATAC/MSM/ComponentTypes  (continued)
  swc implementation ModeAdjust_Implementation: behavior=ModeAdjust_InternalBehavior
    code-descriptors:
      code Default: artifact-descriptors=autosar-engineering-object={short-label=Default, category=SWSRC}
package /PATAC/MSM/DataTypes
  impl type SeatChldLkSt: category=VALUE, base-type=uint8, compu {0=ChldLkSt_NoActive, 1=ChldLkSt_Lock, 2=ChldLkSt_Unlock}
package /PATAC/MSM/DataTypes/ImplementationDataTypes
  impl type AdpnReclnUpwdDnwdPosTbl: category=ARRAY, sw-calibration-access=READ-ONLY, type-emitter=RTE
    element Element: array-size=7, array-size-semantics=FIXED-SIZE, implementation-data-type=UInt16
  impl type IfVeSMSeStNumConfig: category=VALUE, base-type=UInt8, sw-calibration-access=READ-ONLY, compu {0=SeatNum4Config, 1=SeatNum6Config, 2=SeatNum7Config, 3=SeatNum4PConfig}, type-emitter=RTE
package /PATAC/MSM/Intervene/PortInterfaces
  sender receiver interface cmdSrv: invalidation-policy{data-element=cmdSrv/Val, handle-invalid=DONT-INVALIDATE}
    data Val: type=Boolean
package /PATAC/MSM/ModeAdjust/CalPortInterface
  7 x parameter interface:
    AdpnHdrstUpwdDnwdPosTable
      parameter data prototype Val: sw-calibration-access=READ-WRITE, type=AdpnHdrstUpwdDnwdPosTbl
    AdpnReclnUpwdDnwdPosTable
      parameter data prototype Val: sw-calibration-access=READ-WRITE, type=AdpnReclnUpwdDnwdPosTbl
    KeSMSbArmscreenMovEnable
      parameter data prototype Val: sw-calibration-access=READ-WRITE, type=Boolean
    KeSMSuMdMotFinshdTm
      parameter data prototype Val: sw-calibration-access=READ-WRITE, type=UInt16
    KeSMSuModeReqDurgTm
      parameter data prototype Val: sw-calibration-access=READ-WRITE, type=UInt16
    MdPosDelta
      parameter data prototype Val: sw-calibration-access=READ-WRITE, type=UInt16
    Pos
      parameter data prototype Val: sw-calibration-access=READ-WRITE, type=UInt16
package /PATAC/MSM/ModeAdjust/DataType
  impl type AdpnHdrstUpwdDnwdPosTbl: category=ARRAY, sw-calibration-access=READ-ONLY, type-emitter=RTE
    element Element: array-size=7, array-size-semantics=FIXED-SIZE, implementation-data-type=UInt16
  impl type PowerMode1: category=VALUE, base-type=UInt8, sw-calibration-access=READ-ONLY, compu {0=PowerMode_Off, 1=PowerMode_Acc, 2=PowerMode_Run, 3=PowerMode_Crank, 4=PowerMode_Invalid}, type-emitter=RTE
  impl type SeatOccupiedSts1: category=VALUE, base-type=UInt8, sw-calibration-access=READ-ONLY, compu {0=SeatOccupiedSts_Unknown, 1=SeatOccupiedSts_Empty, 2=SeatOccupiedSts_Occupied, 3=SeatOccupiedSts_DataNotAvailable}, type-emitter=RTE
package /PATAC/MSM/ModeAdjust/Interfaces
  43 x sender receiver interface:
    IfVeSMSbDrvStRclCmdSrv: invalidation-policy{data-element=IfVeSMSbDrvStRclCmdSrv/Val, handle-invalid=DONT-INVALIDATE}
      data Val: type=Boolean
    IfVeSMSbSecRwRtStRclCmdSrv: invalidation-policy{data-element=IfVeSMSbSecRwRtStRclCmdSrv/Val, handle-invalid=DONT-INVALIDATE}
      data Val: type=Boolean
    IfVeSMSbThdRwLtStRclCmdSrv: invalidation-policy{data-element=IfVeSMSbThdRwLtStRclCmdSrv/Val, handle-invalid=DONT-INVALIDATE}
      data Val: type=Boolean
    IfVeSMSbThdRwRtStRclCmdSrv: invalidation-policy{data-element=IfVeSMSbThdRwRtStRclCmdSrv/Val, handle-invalid=DONT-INVALIDATE}
      data Val: type=Boolean
    IfVeSMSeNotSecRowLeSeaOccStat: invalidation-policy{data-element=IfVeSMSeNotSecRowLeSeaOccStat/Val, handle-invalid=DONT-INVALIDATE}
      data Val: type=SeatOccupiedSts1
    IfVeSMSeNotSecRowRtSeaOccStat: invalidation-policy{data-element=IfVeSMSeNotSecRowRtSeaOccStat/Val, handle-invalid=DONT-INVALIDATE}
      data Val: type=SeatOccupiedSts1
    IfVeSMSeNotThdRowRtSeaOccStat: invalidation-policy{data-element=IfVeSMSeNotThdRowRtSeaOccStat/Val, handle-invalid=DONT-INVALIDATE}
      data Val: type=SeatOccupiedSts1
    IfVeSMSeNotThdRwCtStOccStat: invalidation-policy{data-element=IfVeSMSeNotThdRwCtStOccStat/Val, handle-invalid=DONT-INVALIDATE}
      data Val: type=SeatOccupiedSts1
    IfVeSMSeNotThdRwLtStOccStat: invalidation-policy{data-element=IfVeSMSeNotThdRwLtStOccStat/Val, handle-invalid=DONT-INVALIDATE}
      data Val: type=SeatOccupiedSts1
    IfVeSMSeSecRwLtStChldLkRsp: invalidation-policy{data-element=IfVeSMSeSecRwLtStChldLkRsp/Val, handle-invalid=DONT-INVALIDATE}
      data Val: type=SeatChldLkSt
    IfVeSMSeSecRwRtStChldLkRsp: invalidation-policy{data-element=IfVeSMSeSecRwRtStChldLkRsp/Val, handle-invalid=DONT-INVALIDATE}
      data Val: type=SeatChldLkSt
    IfVeSMSuDrvStBkReclnUpwdDnwdPosV: invalidation-policy{data-element=IfVeSMSuDrvStBkReclnUpwdDnwdPosV/Val, handle-invalid=DONT-INVALIDATE}
      data Val: type=Boolean
    IfVeSMSuDrvStCshnFrntUpwdDnwdPosV: invalidation-policy{data-element=IfVeSMSuDrvStCshnFrntUpwdDnwdPosV/Val, handle-invalid=DONT-INVALIDATE}
      data Val: type=Boolean
    IfVeSMSuDrvStCshnRrUpwdDnwdPosV: invalidation-policy{data-element=IfVeSMSuDrvStCshnRrUpwdDnwdPosV/Val, handle-invalid=DONT-INVALIDATE}
      data Val: type=Boolean
    IfVeSMSuDrvStFrwdBkwdPosV: invalidation-policy{data-element=IfVeSMSuDrvStFrwdBkwdPosV/Val, handle-invalid=DONT-INVALIDATE}
      data Val: type=Boolean
    IfVeSMSuDrvStFtUpwdDnwdPosV: invalidation-policy{data-element=IfVeSMSuDrvStFtUpwdDnwdPosV/Val, handle-invalid=DONT-INVALIDATE}
      data Val: type=Boolean
    IfVeSMSuPassStBkReclnUpwdDnwdPosV: invalidation-policy{data-element=IfVeSMSuPassStBkReclnUpwdDnwdPosV/Val, handle-invalid=DONT-INVALIDATE}
      data Val: type=Boolean
    IfVeSMSuPassStCshnFrntUpwdDnwdPosV: invalidation-policy{data-element=IfVeSMSuPassStCshnFrntUpwdDnwdPosV/Val, handle-invalid=DONT-INVALIDATE}
      data Val: type=Boolean
    IfVeSMSuPassStCshnRrUpwdDnwdPosV: invalidation-policy{data-element=IfVeSMSuPassStCshnRrUpwdDnwdPosV/Val, handle-invalid=DONT-INVALIDATE}
      data Val: type=Boolean
    IfVeSMSuPassStFrwdBkwdPosV: invalidation-policy{data-element=IfVeSMSuPassStFrwdBkwdPosV/Val, handle-invalid=DONT-INVALIDATE}
      data Val: type=Boolean
    IfVeSMSuPassStFtUpwdDnwdPosV: invalidation-policy{data-element=IfVeSMSuPassStFtUpwdDnwdPosV/Val, handle-invalid=DONT-INVALIDATE}
      data Val: type=Boolean
    IfVeSMSuPassStRclCmdSrv: invalidation-policy{data-element=IfVeSMSuPassStRclCmdSrv/Val, handle-invalid=DONT-INVALIDATE}
      data Val: type=Boolean
    IfVeSMSuSecRwLtStBkReclnUpwdDnwdPosV: invalidation-policy{data-element=IfVeSMSuSecRwLtStBkReclnUpwdDnwdPosV/Val, handle-invalid=DONT-INVALIDATE}
      data Val: type=Boolean
    IfVeSMSuSecRwLtStFrwdBkwdPosV: invalidation-policy{data-element=IfVeSMSuSecRwLtStFrwdBkwdPosV/Val, handle-invalid=DONT-INVALIDATE}
      data Val: type=Boolean
    IfVeSMSuSecRwLtStHdrstUpwdDnwdPosV: invalidation-policy{data-element=IfVeSMSuSecRwLtStHdrstUpwdDnwdPosV/Val, handle-invalid=DONT-INVALIDATE}
      data Val: type=Boolean
    IfVeSMSuSecRwLtStLgrstUpwdDnwdPosV: invalidation-policy{data-element=IfVeSMSuSecRwLtStLgrstUpwdDnwdPosV/Val, handle-invalid=DONT-INVALIDATE}
      data Val: type=Boolean
    IfVeSMSuSecRwLtStLtwdRtwdPosV: invalidation-policy{data-element=IfVeSMSuSecRwLtStLtwdRtwdPosV/Val, handle-invalid=DONT-INVALIDATE}
      data Val: type=Boolean
    IfVeSMSuSecRwLtStRclCmdSrv: invalidation-policy{data-element=IfVeSMSuSecRwLtStRclCmdSrv/Val, handle-invalid=DONT-INVALIDATE}
      data Val: type=Boolean
    IfVeSMSuSecRwRtStBkReclnUpwdDnwdPosV: invalidation-policy{data-element=IfVeSMSuSecRwRtStBkReclnUpwdDnwdPosV/Val, handle-invalid=DONT-INVALIDATE}
      data Val: type=Boolean
    IfVeSMSuSecRwRtStFrwdBkwdPosV: invalidation-policy{data-element=IfVeSMSuSecRwRtStFrwdBkwdPosV/Val, handle-invalid=DONT-INVALIDATE}
      data Val: type=Boolean
    IfVeSMSuSecRwRtStHPassStUpwdDnwdPosV: invalidation-policy{data-element=IfVeSMSuSecRwRtStHPassStUpwdDnwdPosV/Val, handle-invalid=DONT-INVALIDATE}
      data Val: type=Boolean
    IfVeSMSuSecRwRtStLgrstUpwdDnwdPosV: invalidation-policy{data-element=IfVeSMSuSecRwRtStLgrstUpwdDnwdPosV/Val, handle-invalid=DONT-INVALIDATE}
      data Val: type=Boolean
    IfVeSMSuSecRwRtStLtwdRtwdPosV: invalidation-policy{data-element=IfVeSMSuSecRwRtStLtwdRtwdPosV/Val, handle-invalid=DONT-INVALIDATE}
      data Val: type=Boolean
    IfVeSMSuThdRwLtStBkReclnUpwdDnwdPosV: invalidation-policy{data-element=IfVeSMSuThdRwLtStBkReclnUpwdDnwdPosV/Val, handle-invalid=DONT-INVALIDATE}
      data Val: type=Boolean
    IfVeSMSuThdRwLtStCshnFldUpwdDnwdPos: invalidation-policy{data-element=IfVeSMSuThdRwLtStCshnFldUpwdDnwdPos/Val, handle-invalid=DONT-INVALIDATE}
      data Val: type=UInt16
    IfVeSMSuThdRwLtStCshnFldUpwdDnwdPosV: invalidation-policy{data-element=IfVeSMSuThdRwLtStCshnFldUpwdDnwdPosV/Val, handle-invalid=DONT-INVALIDATE}
      data Val: type=Boolean
    IfVeSMSuThdRwLtStCshnFldUpwdDnwdTrgtPos: invalidation-policy{data-element=IfVeSMSuThdRwLtStCshnFldUpwdDnwdTrgtPos/Val, handle-invalid=DONT-INVALIDATE}
      data Val: type=UInt16
    IfVeSMSuThdRwLtStFrwdBkwdPosV: invalidation-policy{data-element=IfVeSMSuThdRwLtStFrwdBkwdPosV/Val, handle-invalid=DONT-INVALIDATE}
      data Val: type=Boolean
    IfVeSMSuThdRwRtStBkReclnUpwdDnwdPosV: invalidation-policy{data-element=IfVeSMSuThdRwRtStBkReclnUpwdDnwdPosV/Val, handle-invalid=DONT-INVALIDATE}
      data Val: type=Boolean
    IfVeSMSuThdRwRtStCshnFldUpwdDnwdPos: invalidation-policy{data-element=IfVeSMSuThdRwRtStCshnFldUpwdDnwdPos/Val, handle-invalid=DONT-INVALIDATE}
      data Val: type=UInt16
    IfVeSMSuThdRwRtStCshnFldUpwdDnwdPosV: invalidation-policy{data-element=IfVeSMSuThdRwRtStCshnFldUpwdDnwdPosV/Val, handle-invalid=DONT-INVALIDATE}
      data Val: type=Boolean
    IfVeSMSuThdRwRtStCshnFldUpwdDnwdTrgtPos: invalidation-policy{data-element=IfVeSMSuThdRwRtStCshnFldUpwdDnwdTrgtPos/Val, handle-invalid=DONT-INVALIDATE}
      data Val: type=UInt16
    IfVeSMSuThdRwRtStFrwdBkwdPosV: invalidation-policy{data-element=IfVeSMSuThdRwRtStFrwdBkwdPosV/Val, handle-invalid=DONT-INVALIDATE}
      data Val: type=Boolean
package /PATAC/MSM/ModeAdjust/PortInterface
  parameter interface IfKeSMSbSeatMovHdUpwdDnwdEnable
    parameter data prototype Val: sw-calibration-access=READ-WRITE, type=Boolean
  parameter interface KeSMSbSeatMovLgrstExpdEnable
    parameter data prototype Val: sw-calibration-access=READ-WRITE, type=Boolean
  13 x sender receiver interface:
    DoneFailed: invalidation-policy{data-element=DoneFailed/Val, handle-invalid=DONT-INVALIDATE}
      data Val: type=Boolean
    DoneOK: invalidation-policy{data-element=DoneOK/Val, handle-invalid=DONT-INVALIDATE}
      data Val: type=Boolean
    IfVeSMSbSecRwRtSLgrstExpdMovConfig: invalidation-policy{data-element=IfVeSMSbSecRwRtSLgrstExpdMovConfig/Val, handle-invalid=DONT-INVALIDATE}
      data Val: type=Boolean
    IfVeSMSbSecRwRtStBlstOtwdInwdMovConfig: invalidation-policy{data-element=IfVeSMSbSecRwRtStBlstOtwdInwdMovConfig/Val, handle-invalid=DONT-INVALIDATE}
      data Val: type=Boolean
    IfVeSMSbSecRwRtStFtrstMovConfig: invalidation-policy{data-element=IfVeSMSbSecRwRtStFtrstMovConfig/Val, handle-invalid=DONT-INVALIDATE}
      data Val: type=Boolean
    IfVeSMSbSecRwRtStHdUpwdDnwdMovConfig: invalidation-policy{data-element=IfVeSMSbSecRwRtStHdUpwdDnwdMovConfig/Val, handle-invalid=DONT-INVALIDATE}
      data Val: type=Boolean
    IfVeSMSeStNumConfig: invalidation-policy{data-element=IfVeSMSeStNumConfig/Val, handle-invalid=DONT-INVALIDATE}
      data Val: type=IfVeSMSeStNumConfig
    IsTargetPos: invalidation-policy{data-element=IsTargetPos/Val, handle-invalid=DONT-INVALIDATE}
      data Val: type=Boolean
    MdRclLgSldSpdCrl: invalidation-policy{data-element=MdRclLgSldSpdCrl/Val, handle-invalid=DONT-INVALIDATE}
      data Val: type=UInt8
    modestate32: invalidation-policy{data-element=modestate32/Val, handle-invalid=DONT-INVALIDATE}
      data Val: type=UInt32
    PercPos: invalidation-policy{data-element=PercPos/Val, handle-invalid=DONT-INVALIDATE}
      data Val: type=UInt16
    PercPosV: invalidation-policy{data-element=PercPosV/Val, handle-invalid=DONT-INVALIDATE}
      data Val: type=Boolean
    PowerMode: invalidation-policy{data-element=PowerMode/Val, handle-invalid=DONT-INVALIDATE}
      data Val: type=PowerMode1
package /PATAC/MSM/PortInterfaces
  8 x parameter interface:
    IfKeSMSbSeatMovBkRclnEnable
      parameter data prototype Val: sw-calibration-access=READ-WRITE, type=Boolean
    IfKeSMSbSeatMovFrwdBkwdEnable
      parameter data prototype Val: sw-calibration-access=READ-WRITE, type=Boolean
    IfKeSMSbSeatMovFtrstEnable
      parameter data prototype Val: sw-calibration-access=READ-WRITE, type=Boolean
    IfKeSMSbSeatMovHdrstFrwdBkwdEnable
      parameter data prototype Val: sw-calibration-access=READ-WRITE, type=Boolean
    IfKeSMSbSeatMovLgrstEnable
      parameter data prototype Val: sw-calibration-access=READ-WRITE, type=Boolean
    IfKeSMSbSeatMovLtwdRtwdEnable
      parameter data prototype Val: sw-calibration-access=READ-WRITE, type=Boolean
    KeSMSuMdRetryTm1
      parameter data prototype Val: sw-calibration-access=READ-WRITE, type=UInt8
    KeSMSuSecRwStVIPFtrstRefAngle
      parameter data prototype Val: sw-calibration-access=READ-WRITE, type=UInt8
  83 x sender receiver interface:
    IfVeSMSbDrvStBkReclnUpwdDnwdMovConfig: invalidation-policy{data-element=IfVeSMSbDrvStBkReclnUpwdDnwdMovConfig/Val, handle-invalid=DONT-INVALIDATE}
      data Val: type=Boolean
    IfVeSMSbDrvStFrwdBkwdMovConfig: invalidation-policy{data-element=IfVeSMSbDrvStFrwdBkwdMovConfig/Val, handle-invalid=DONT-INVALIDATE}
      data Val: type=Boolean
    IfVeSMSbDrvStFtUpwdDnwdMovConfig: invalidation-policy{data-element=IfVeSMSbDrvStFtUpwdDnwdMovConfig/Val, handle-invalid=DONT-INVALIDATE}
      data Val: type=Boolean
    IfVeSMSbPassStBkReclnUpwdDnwdMovConfig: invalidation-policy{data-element=IfVeSMSbPassStBkReclnUpwdDnwdMovConfig/Val, handle-invalid=DONT-INVALIDATE}
      data Val: type=Boolean
    IfVeSMSbPassStFrwdBkwdMovConfig: invalidation-policy{data-element=IfVeSMSbPassStFrwdBkwdMovConfig/Val, handle-invalid=DONT-INVALIDATE}
      data Val: type=Boolean
    IfVeSMSbPassStFtUpwdDnwdMovConfig: invalidation-policy{data-element=IfVeSMSbPassStFtUpwdDnwdMovConfig/Val, handle-invalid=DONT-INVALIDATE}
      data Val: type=Boolean
    IfVeSMSbSecRwRtStBkReclnUpwdDnwdMovConfig: invalidation-policy{data-element=IfVeSMSbSecRwRtStBkReclnUpwdDnwdMovConfig/Val, handle-invalid=DONT-INVALIDATE}
      data Val: type=Boolean
    IfVeSMSbSecRwRtStFrwdBkwdMovConfig: invalidation-policy{data-element=IfVeSMSbSecRwRtStFrwdBkwdMovConfig/Val, handle-invalid=DONT-INVALIDATE}
      data Val: type=Boolean
    IfVeSMSbSecRwRtStHdrstFrwdBkwdMovConfig: invalidation-policy{data-element=IfVeSMSbSecRwRtStHdrstFrwdBkwdMovConfig/Val, handle-invalid=DONT-INVALIDATE}
      data Val: type=Boolean
    IfVeSMSbSecRwRtStLgrstUpwdMovConfig: invalidation-policy{data-element=IfVeSMSbSecRwRtStLgrstUpwdMovConfig/Val, handle-invalid=DONT-INVALIDATE}
      data Val: type=Boolean
    IfVeSMSbSecRwRtStLtwdRtwdMovConfig: invalidation-policy{data-element=IfVeSMSbSecRwRtStLtwdRtwdMovConfig/Val, handle-invalid=DONT-INVALIDATE}
      data Val: type=Boolean
    IfVeSMSbThdRwLtStBkReclnUpwdDnwdMovConfig: invalidation-policy{data-element=IfVeSMSbThdRwLtStBkReclnUpwdDnwdMovConfig/Val, handle-invalid=DONT-INVALIDATE}
      data Val: type=Boolean
    IfVeSMSbThdRwLtStCshnFldUpwdDnwdMovConfig: invalidation-policy{data-element=IfVeSMSbThdRwLtStCshnFldUpwdDnwdMovConfig/Val, handle-invalid=DONT-INVALIDATE}
      data Val: type=Boolean
    IfVeSMSbThdRwLtStFrwdBkwdMovConfig: invalidation-policy{data-element=IfVeSMSbThdRwLtStFrwdBkwdMovConfig/Val, handle-invalid=DONT-INVALIDATE}
      data Val: type=Boolean
    IfVeSMSbThdRwRtStBkReclnUpwdDnwdMovConfig: invalidation-policy{data-element=IfVeSMSbThdRwRtStBkReclnUpwdDnwdMovConfig/Val, handle-invalid=DONT-INVALIDATE}
      data Val: type=Boolean
    IfVeSMSbThdRwRtStCshnFldUpwdDnwdMovConfig: invalidation-policy{data-element=IfVeSMSbThdRwRtStCshnFldUpwdDnwdMovConfig/Val, handle-invalid=DONT-INVALIDATE}
      data Val: type=Boolean
    IfVeSMSbThdRwRtStFrwdBkwdMovConfig: invalidation-policy{data-element=IfVeSMSbThdRwRtStFrwdBkwdMovConfig/Val, handle-invalid=DONT-INVALIDATE}
      data Val: type=Boolean
    IfVeSMSuDrvStBkReclnUpwdDnwdPos: invalidation-policy{data-element=IfVeSMSuDrvStBkReclnUpwdDnwdPos/Val, handle-invalid=DONT-INVALIDATE}
      data Val: type=UInt16
    IfVeSMSuDrvStBkReclnUpwdDnwdTrgtPos: invalidation-policy{data-element=IfVeSMSuDrvStBkReclnUpwdDnwdTrgtPos/Val, handle-invalid=DONT-INVALIDATE}
      data Val: type=UInt16
    IfVeSMSuDrvStCshnFrntUpwdDnwdPos: invalidation-policy{data-element=IfVeSMSuDrvStCshnFrntUpwdDnwdPos/Val, handle-invalid=DONT-INVALIDATE}
      data Val: type=UInt16
    IfVeSMSuDrvStCshnFrntUpwdDnwdTrgtPos: invalidation-policy{data-element=IfVeSMSuDrvStCshnFrntUpwdDnwdTrgtPos/Val, handle-invalid=DONT-INVALIDATE}
      data Val: type=UInt16
    IfVeSMSuDrvStCshnRrUpwdDnwdPos: invalidation-policy{data-element=IfVeSMSuDrvStCshnRrUpwdDnwdPos/Val, handle-invalid=DONT-INVALIDATE}
      data Val: type=UInt16
    IfVeSMSuDrvStCshnRrUpwdDnwdTrgtPos: invalidation-policy{data-element=IfVeSMSuDrvStCshnRrUpwdDnwdTrgtPos/Val, handle-invalid=DONT-INVALIDATE}
      data Val: type=UInt16
    IfVeSMSuDrvStFrwdBkwdPos: invalidation-policy{data-element=IfVeSMSuDrvStFrwdBkwdPos/Val, handle-invalid=DONT-INVALIDATE}
      data Val: type=UInt16
    IfVeSMSuDrvStFrwdBkwdTrgtPos: invalidation-policy{data-element=IfVeSMSuDrvStFrwdBkwdTrgtPos/Val, handle-invalid=DONT-INVALIDATE}
      data Val: type=UInt16
    IfVeSMSuDrvStFtUpwdDnwdPos: invalidation-policy{data-element=IfVeSMSuDrvStFtUpwdDnwdPos/Val, handle-invalid=DONT-INVALIDATE}
      data Val: type=UInt16
    IfVeSMSuDrvStFtUpwdDnwdTrgtPos: invalidation-policy{data-element=IfVeSMSuDrvStFtUpwdDnwdTrgtPos/Val, handle-invalid=DONT-INVALIDATE}
      data Val: type=UInt16
    IfVeSMSuPassStBkReclnUpwdDnwdPos: invalidation-policy{data-element=IfVeSMSuPassStBkReclnUpwdDnwdPos/Val, handle-invalid=DONT-INVALIDATE}
      data Val: type=UInt16
    IfVeSMSuPassStBkReclnUpwdDnwdTrgtPos: invalidation-policy{data-element=IfVeSMSuPassStBkReclnUpwdDnwdTrgtPos/Val, handle-invalid=DONT-INVALIDATE}
      data Val: type=UInt16
    IfVeSMSuPassStCshnFrntUpwdDnwdPos: invalidation-policy{data-element=IfVeSMSuPassStCshnFrntUpwdDnwdPos/Val, handle-invalid=DONT-INVALIDATE}
      data Val: type=UInt16
    IfVeSMSuPassStCshnFrntUpwdDnwdTrgtPos: invalidation-policy{data-element=IfVeSMSuPassStCshnFrntUpwdDnwdTrgtPos/Val, handle-invalid=DONT-INVALIDATE}
      data Val: type=UInt16
    IfVeSMSuPassStCshnRrUpwdDnwdPos: invalidation-policy{data-element=IfVeSMSuPassStCshnRrUpwdDnwdPos/Val, handle-invalid=DONT-INVALIDATE}
      data Val: type=UInt16
    IfVeSMSuPassStCshnRrUpwdDnwdTrgtPos: invalidation-policy{data-element=IfVeSMSuPassStCshnRrUpwdDnwdTrgtPos/Val, handle-invalid=DONT-INVALIDATE}
      data Val: type=UInt16
    IfVeSMSuPassStFrwdBkwdPos: invalidation-policy{data-element=IfVeSMSuPassStFrwdBkwdPos/Val, handle-invalid=DONT-INVALIDATE}
      data Val: type=UInt16
    IfVeSMSuPassStFrwdBkwdTrgtPos: invalidation-policy{data-element=IfVeSMSuPassStFrwdBkwdTrgtPos/Val, handle-invalid=DONT-INVALIDATE}
      data Val: type=UInt16
    IfVeSMSuPassStFtUpwdDnwdPos: invalidation-policy{data-element=IfVeSMSuPassStFtUpwdDnwdPos/Val, handle-invalid=DONT-INVALIDATE}
      data Val: type=UInt16
    IfVeSMSuPassStFtUpwdDnwdTrgtPos: invalidation-policy{data-element=IfVeSMSuPassStFtUpwdDnwdTrgtPos/Val, handle-invalid=DONT-INVALIDATE}
      data Val: type=UInt16
    IfVeSMSuRrLtStFtUpwdDnwdPos: invalidation-policy{data-element=IfVeSMSuRrLtStFtUpwdDnwdPos/Val, handle-invalid=DONT-INVALIDATE}
      data Val: type=UInt16
    IfVeSMSuRrLtStFtUpwdDnwdPosV: invalidation-policy{data-element=IfVeSMSuRrLtStFtUpwdDnwdPosV/Val, handle-invalid=DONT-INVALIDATE}
      data Val: type=Boolean
    IfVeSMSuRrLtStFtUpwdDnwdTrgtPos: invalidation-policy{data-element=IfVeSMSuRrLtStFtUpwdDnwdTrgtPos/Val, handle-invalid=DONT-INVALIDATE}
      data Val: type=UInt16
    IfVeSMSuRrRtStFtUpwdDnwdPos: invalidation-policy{data-element=IfVeSMSuRrRtStFtUpwdDnwdPos/Val, handle-invalid=DONT-INVALIDATE}
      data Val: type=UInt16
    IfVeSMSuRrRtStFtUpwdDnwdPosV: invalidation-policy{data-element=IfVeSMSuRrRtStFtUpwdDnwdPosV/Val, handle-invalid=DONT-INVALIDATE}
      data Val: type=Boolean
    IfVeSMSuRrRtStFtUpwdDnwdTrgtPos: invalidation-policy{data-element=IfVeSMSuRrRtStFtUpwdDnwdTrgtPos/Val, handle-invalid=DONT-INVALIDATE}
      data Val: type=UInt16
    IfVeSMSuSecRwLtStArmScrnTrgtPos: invalidation-policy{data-element=IfVeSMSuSecRwLtStArmScrnTrgtPos/Val, handle-invalid=DONT-INVALIDATE}
      data Val: type=UInt16
    IfVeSMSuSecRwLtStBkReclnUpwdDnwdPos: invalidation-policy{data-element=IfVeSMSuSecRwLtStBkReclnUpwdDnwdPos/Val, handle-invalid=DONT-INVALIDATE}
      data Val: type=UInt16
    IfVeSMSuSecRwLtStBkReclnUpwdDnwdTrgtPos: invalidation-policy{data-element=IfVeSMSuSecRwLtStBkReclnUpwdDnwdTrgtPos/Val, handle-invalid=DONT-INVALIDATE}
      data Val: type=UInt16
    IfVeSMSuSecRwLtStFrwdBkwdPos: invalidation-policy{data-element=IfVeSMSuSecRwLtStFrwdBkwdPos/Val, handle-invalid=DONT-INVALIDATE}
      data Val: type=UInt16
    IfVeSMSuSecRwLtStFrwdBkwdTrgtPos: invalidation-policy{data-element=IfVeSMSuSecRwLtStFrwdBkwdTrgtPos/Val, handle-invalid=DONT-INVALIDATE}
      data Val: type=UInt16
    IfVeSMSuSecRwLtStHdrstFrwdBkwdPos: invalidation-policy{data-element=IfVeSMSuSecRwLtStHdrstFrwdBkwdPos/Val, handle-invalid=DONT-INVALIDATE}
      data Val: type=UInt16
    IfVeSMSuSecRwLtStHdrstFrwdBkwdPosV: invalidation-policy{data-element=IfVeSMSuSecRwLtStHdrstFrwdBkwdPosV/Val, handle-invalid=DONT-INVALIDATE}
      data Val: type=Boolean
    IfVeSMSuSecRwLtStHdrstUpwdDnwdPos: invalidation-policy{data-element=IfVeSMSuSecRwLtStHdrstUpwdDnwdPos/Val, handle-invalid=DONT-INVALIDATE}
      data Val: type=UInt16
    IfVeSMSuSecRwLtStHdrstUpwdDnwdTrgtPos: invalidation-policy{data-element=IfVeSMSuSecRwLtStHdrstUpwdDnwdTrgtPos/Val, handle-invalid=DONT-INVALIDATE}
      data Val: type=UInt16
    IfVeSMSuSecRwLtStLgrstOtwdInwdPos: invalidation-policy{data-element=IfVeSMSuSecRwLtStLgrstOtwdInwdPos/Val, handle-invalid=DONT-INVALIDATE}
      data Val: type=UInt16
    IfVeSMSuSecRwLtStLgrstOtwdInwdPosV: invalidation-policy{data-element=IfVeSMSuSecRwLtStLgrstOtwdInwdPosV/Val, handle-invalid=DONT-INVALIDATE}
      data Val: type=Boolean
    IfVeSMSuSecRwLtStLgrstOtwdInwdTrgtPos: invalidation-policy{data-element=IfVeSMSuSecRwLtStLgrstOtwdInwdTrgtPos/Val, handle-invalid=DONT-INVALIDATE}
      data Val: type=UInt16
    IfVeSMSuSecRwLtStLgrstUpwdDnwdPos: invalidation-policy{data-element=IfVeSMSuSecRwLtStLgrstUpwdDnwdPos/Val, handle-invalid=DONT-INVALIDATE}
      data Val: type=UInt16
    IfVeSMSuSecRwLtStLgrstUpwdDnwdTrgtPos: invalidation-policy{data-element=IfVeSMSuSecRwLtStLgrstUpwdDnwdTrgtPos/Val, handle-invalid=DONT-INVALIDATE}
      data Val: type=UInt16
    IfVeSMSuSecRwLtStLtwdRtwdPos: invalidation-policy{data-element=IfVeSMSuSecRwLtStLtwdRtwdPos/Val, handle-invalid=DONT-INVALIDATE}
      data Val: type=UInt16
    IfVeSMSuSecRwLtStLtwdRtwdTrgtPos: invalidation-policy{data-element=IfVeSMSuSecRwLtStLtwdRtwdTrgtPos/Val, handle-invalid=DONT-INVALIDATE}
      data Val: type=UInt16
    IfVeSMSuSecRwRtStArmScrnTrgtPos: invalidation-policy{data-element=IfVeSMSuSecRwRtStArmScrnTrgtPos/Val, handle-invalid=DONT-INVALIDATE}
      data Val: type=UInt16
    IfVeSMSuSecRwRtStBkReclnUpwdDnwdPos: invalidation-policy{data-element=IfVeSMSuSecRwRtStBkReclnUpwdDnwdPos/Val, handle-invalid=DONT-INVALIDATE}
      data Val: type=UInt16
    IfVeSMSuSecRwRtStBkReclnUpwdDnwdTrgtPos: invalidation-policy{data-element=IfVeSMSuSecRwRtStBkReclnUpwdDnwdTrgtPos/Val, handle-invalid=DONT-INVALIDATE}
      data Val: type=UInt16
    IfVeSMSuSecRwRtStFrwdBkwdTrgtPos: invalidation-policy{data-element=IfVeSMSuSecRwRtStFrwdBkwdTrgtPos/Val, handle-invalid=DONT-INVALIDATE}
      data Val: type=UInt16
    IfVeSMSuSecRwRtStHdrstFrwdBkwdPos: invalidation-policy{data-element=IfVeSMSuSecRwRtStHdrstFrwdBkwdPos/Val, handle-invalid=DONT-INVALIDATE}
      data Val: type=UInt16
    IfVeSMSuSecRwRtStHdrstFrwdBkwdPosV: invalidation-policy{data-element=IfVeSMSuSecRwRtStHdrstFrwdBkwdPosV/Val, handle-invalid=DONT-INVALIDATE}
      data Val: type=Boolean
    IfVeSMSuSecRwRtStHdrstUpwdDnwdPos: invalidation-policy{data-element=IfVeSMSuSecRwRtStHdrstUpwdDnwdPos/Val, handle-invalid=DONT-INVALIDATE}
      data Val: type=UInt16
    IfVeSMSuSecRwRtStHdrstUpwdDnwdTrgtPos: invalidation-policy{data-element=IfVeSMSuSecRwRtStHdrstUpwdDnwdTrgtPos/Val, handle-invalid=DONT-INVALIDATE}
      data Val: type=UInt16
    IfVeSMSuSecRwRtStLgrstOtwdInwdPos: invalidation-policy{data-element=IfVeSMSuSecRwRtStLgrstOtwdInwdPos/Val, handle-invalid=DONT-INVALIDATE}
      data Val: type=UInt16
    IfVeSMSuSecRwRtStLgrstOtwdInwdPosV: invalidation-policy{data-element=IfVeSMSuSecRwRtStLgrstOtwdInwdPosV/Val, handle-invalid=DONT-INVALIDATE}
      data Val: type=Boolean
    IfVeSMSuSecRwRtStLgrstOtwdInwdTrgtPos: invalidation-policy{data-element=IfVeSMSuSecRwRtStLgrstOtwdInwdTrgtPos/Val, handle-invalid=DONT-INVALIDATE}
      data Val: type=UInt16
    IfVeSMSuSecRwRtStLgrstUpwdDnwdPos: invalidation-policy{data-element=IfVeSMSuSecRwRtStLgrstUpwdDnwdPos/Val, handle-invalid=DONT-INVALIDATE}
      data Val: type=UInt16
    IfVeSMSuSecRwRtStLgrstUpwdDnwdTrgtPos: invalidation-policy{data-element=IfVeSMSuSecRwRtStLgrstUpwdDnwdTrgtPos/Val, handle-invalid=DONT-INVALIDATE}
      data Val: type=UInt16
    IfVeSMSuSecRwRtStLtwdRtwdPos: invalidation-policy{data-element=IfVeSMSuSecRwRtStLtwdRtwdPos/Val, handle-invalid=DONT-INVALIDATE}
      data Val: type=UInt16
    IfVeSMSuSecRwRtStLtwdRtwdTrgtPos: invalidation-policy{data-element=IfVeSMSuSecRwRtStLtwdRtwdTrgtPos/Val, handle-invalid=DONT-INVALIDATE}
      data Val: type=UInt16
    IfVeSMSuThdRwLtStBkReclnUpwdDnwdPos: invalidation-policy{data-element=IfVeSMSuThdRwLtStBkReclnUpwdDnwdPos/Val, handle-invalid=DONT-INVALIDATE}
      data Val: type=UInt16
    IfVeSMSuThdRwLtStBkReclnUpwdDnwdTrgtPos: invalidation-policy{data-element=IfVeSMSuThdRwLtStBkReclnUpwdDnwdTrgtPos/Val, handle-invalid=DONT-INVALIDATE}
      data Val: type=UInt16
    IfVeSMSuThdRwLtStFrwdBkwdPos: invalidation-policy{data-element=IfVeSMSuThdRwLtStFrwdBkwdPos/Val, handle-invalid=DONT-INVALIDATE}
      data Val: type=UInt16
    IfVeSMSuThdRwLtStFrwdBkwdTrgtPos: invalidation-policy{data-element=IfVeSMSuThdRwLtStFrwdBkwdTrgtPos/Val, handle-invalid=DONT-INVALIDATE}
      data Val: type=UInt16
    IfVeSMSuThdRwRStFrwdBkwdPos: invalidation-policy{data-element=IfVeSMSuThdRwRStFrwdBkwdPos/Val, handle-invalid=DONT-INVALIDATE}
      data Val: type=UInt16
    IfVeSMSuThdRwRtStBkReclnUpwdDnwdPos: invalidation-policy{data-element=IfVeSMSuThdRwRtStBkReclnUpwdDnwdPos/Val, handle-invalid=DONT-INVALIDATE}
      data Val: type=UInt16
    IfVeSMSuThdRwRtStBkReclnUpwdDnwdTrgtPos: invalidation-policy{data-element=IfVeSMSuThdRwRtStBkReclnUpwdDnwdTrgtPos/Val, handle-invalid=DONT-INVALIDATE}
      data Val: type=UInt16
    IfVeSMSuThdRwRtStFrwdBkwdTrgtPos: invalidation-policy{data-element=IfVeSMSuThdRwRtStFrwdBkwdTrgtPos/Val, handle-invalid=DONT-INVALIDATE}
      data Val: type=UInt16
    TrgtPos: invalidation-policy{data-element=TrgtPos/Val, handle-invalid=DONT-INVALIDATE}
      data Val: type=UInt16
