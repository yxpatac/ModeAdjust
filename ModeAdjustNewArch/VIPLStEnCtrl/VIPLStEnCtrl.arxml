AUTOSAR XML (schema 4-0-3)
package /PATAC/MSM/ModeAdjust/PortInterface
  client server interface VIPLStEnCtrl
    operation Cal
