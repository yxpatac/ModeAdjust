AUTOSAR XML (schema 4-0-3)
standard types defined: float32, float32_DataConstr, UInt16, UInt8
package /AUTOSAR_Platform/DataConstrs
  range DC_UInt16: raw 0..65535
  range DC_UInt8: raw 0..255
package /PATAC/MSM/Intervene/PortInterfaces
  client server interface VIPD1D2Calc
    operation Cal
      7 x arg, all with server-argument-impl-policy=USE-ARGUMENT-TYPE:
        Safetyd1: type=UInt16, direction=IN
        Safetyd2: type=UInt16, direction=IN
        X: type=UInt16, direction=IN
        Y: type=float32, direction=IN
        arg: type=UInt8, direction=IN
        D1: type=float32, direction=OUT
        D2: type=float32, direction=OUT
